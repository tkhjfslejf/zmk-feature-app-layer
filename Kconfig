## Kconfig
```kconfig
config ZMK_APP_LAYER_AUTOSWITCH
    bool "Automatic application layer switching"
    depends on RAW_HID
    default y
```

## west.yml
```yaml
manifest:
  remotes:
    - name: zzeneg
      url-base: https://github.com/zzeneg
  projects:
    - name: zmk-raw-hid
      remote: zzeneg
      revision: main
```
